#include <Wire.h>
#include <Adafruit_MCP4725.h>
#define voltsIn A0

/////////////////////////
float my_bpm = 400.f;
int cstart = 0;
int clength = 2000;
////////////////////////

float co2[] = {315.7,317.45,317.51,315.86,314.93,313.21,313.33,314.67,315.58,316.48,316.65,317.72,318.29,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410.92,411.66};
// c02 measurements from the Mauna Loa Observatory, 1958 - present
int array_length = 0;

Adafruit_MCP4725 dac; // constructor


void setup(void) {
  Serial.begin(9600);
  dac.begin(0x60); // The I2C Address: Run the I2C Scanner if you're not sure  
  array_length = sizeof(co2)/sizeof(float);
}

int bpm_time (float bpm) {
  return int((60./bpm)*1000. + 0.5);
}

int trigger_pattern (int count) {
    int result = 0;
    int cycle0 = 1 << 0;
    int cycle1 = 1 << 1;
    int cycle2 = 1 << 2;
    int cycle3 = 1 << 3;
    int cycle4 = 1 << 4;
    int cycle5 = 1 << 5;
    int cycle6 = 1 << 6;
    int cycle7 = 1 << 7;
    
    if (count % 1 == 0)
        result |= cycle0;
    if (count % 2 == 0)
        result |= cycle1;
    if (count % 3 == 0)
        result |= cycle2;
    if (count % 5 == 0)
        result |= cycle3;
    if (count % 7 == 0)
        result |= cycle4;
    if (count % 11 == 0)
        result |= cycle5;
    if (count % 13 == 0)
        result |= cycle6;
    if (count % 17 == 0)
        result |= cycle7;
    
    return result;
}

int trigger_pattern2 (int count) {
    int result = 0;
      
    if (count % 1 == 0)
        result += 100;
    if (count % 2 == 0)
        result += 200;
    if (count % 3 == 0)
        result += 300;
    if (count % 5 == 0)
        result += 400;
    if (count % 7 == 0)
        result += 500;
    if (count % 11 == 0)
        result += 600;
    if (count % 13 == 0)
        result += 700;
    if (count % 17 == 0)
        result += 800;
    
    return result;
}

void loop(void) {
  
    uint32_t dac_value;
    
    for (int i = cstart; i < clength; i++){

      
      dac.setVoltage(trigger_pattern2 (i)*1, false);

      //dac.setVoltage(co2[i%array_length], false);
      
      delay (bpm_time (my_bpm));  
    }
   
}
